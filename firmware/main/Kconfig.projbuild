## firmware/main/Kconfig.projbuild
```kconfig
menu "Raeucherofensteuerung"

    config ROF_ONEWIRE_GPIO
        int "GPIO des 1-Wire-Busses (DS18B20)"
        range 0 48
        default 4
        help
            Datenleitung der DS18B20. Braucht einen Pull-up von 4,7 kOhm
            nach 3,3 V. Die Sensoren werden ueber VDD versorgt, nicht
            parasitaer.

    config ROF_LED_GPIO
        int "GPIO der LED (statt Heizelement)"
        range 0 48
        default 5
        help
            LED mit Vorwiderstand zwischen diesem Pin und Masse. Die
            eingebaute RGB-LED der DevKitC-1 ist adressierbar und eignet
            sich nicht.

    config ROF_WIFI_SSID
        string "Name des WLANs (SSID)"
        default "Raeucherofen"
        help
            1 bis 32 Zeichen.

    config ROF_WIFI_PASSWORD
        string "WLAN-Passwort (WPA2, 8 bis 63 Zeichen)"
        default "bitte-aendern"
        help
            Der Standard ist ein Platzhalter und steht oeffentlich im
            Repository. Mit ihm startet der Access Point nicht, die
            Regelung laeuft dann ohne WLAN. Das echte Passwort steht nur
            in firmware/sdkconfig, und diese Datei ist nicht im Repository.

endmenu
```
